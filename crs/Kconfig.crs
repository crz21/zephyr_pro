## crs/Kconfig.crs
```kconfig
menuconfig BT_CRS
	bool "GATT Cr data service"

if BT_CRS

choice BT_CRS_DEFAULT_PERM
	prompt "Default permissions used for CRS characteristics"
	default BT_CRS_DEFAULT_PERM_RW
	help
	  Default permissions for CRS characteristic attributes
	  used when no permission is set for the report.
	  Used also for boot reports.

config BT_CRS_DEFAULT_PERM_RW
	bool "Read and write allowed"

config BT_CRS_DEFAULT_PERM_RW_ENCRYPT
	bool "Require encryption for access"

config BT_CRS_DEFAULT_PERM_RW_AUTHEN
	bool "Require encryption and authentication for access"

endchoice

endif
```

## func_demo/Kconfig
```kconfig
source "Kconfig.zephyr"

config CUSTOM_BLINKY
    bool "Enable Blinky Function"
    default n
    help
      This option eable the custom blinky function.

config CUSTOM_UART
    bool "Enable custom uart Function"
    default n
    help
      This option eable the custom uart function.

config BMP280_PS
    bool "Enable bmp280 pressure sensor Function"
    default n
    help
      This option eable the bmp280 pressure sensor function.

config CUSTOM_SPI
    bool "Enable Custom Spi Function"
    default n
    help
      This option eable the Custom Spi function.
```
