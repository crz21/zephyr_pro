## CMakeLists.txt
```
#
# Copyright (c) 2020 Nordic Semiconductor ASA
#
# SPDX-License-Identifier: LicenseRef-Nordic-5-Clause
#

cmake_minimum_required(VERSION 3.20.0)

find_package(Zephyr REQUIRED HINTS $ENV{ZEPHYR_BASE})

project(openthread_coap_router)

FILE(GLOB app_sources src/*.c)
# NORDIC SDK APP START
target_sources(app PRIVATE ${app_sources})

target_include_directories(app PRIVATE src)
# NORDIC SDK APP END
```

## Kconfig
```
#
# Copyright (c) 2020 Nordic Semiconductor ASA
#
# SPDX-License-Identifier: LicenseRef-Nordic-5-Clause
#

menu "Zephyr Kernel"
source "Kconfig.zephyr"
endmenu

module = OT_COMMAND_LINE_INTERFACE
module-str = ot_cli
source "$(ZEPHYR_BASE)/subsys/logging/Kconfig.template.log_config"


config CLI_SAMPLE_MULTIPROTOCOL
	bool "Multiprotocol for the CLI sample"
```

## sample.yaml
```
sample:
  description: Test CoAP communication in Thread network
  name: OpenThread CoAP Server

tests:
  sample.openthread.cli.multiprotocol:
    sysbuild: true
    build_only: true
    tags:
      - ci_build
      - sysbuild
      - ci_samples_openthread
    platform_allow:
      - nrf52840dk/nrf52840
      - nrf52840dongle/nrf52840
      - nrf21540dk/nrf52840
      - nrf5340dk/nrf5340/cpuapp
      - nrf54l15dk/nrf54l15/cpuapp
      - nrf54l15dk/nrf54l10/cpuapp
      - nrf54l15dk/nrf54l15/cpuapp/ns
      - nrf54lm20dk/nrf54lm20a/cpuapp
    extra_args:
      - cli_SNIPPET="ot-ci;ot-logging"
      - EXTRA_CONF_FILE="extra_conf/multiprotocol.conf;extra_conf/tcp.conf"
      - CONFIG_OTPERF=y
      - FILE_SUFFIX=ble
    integration_platforms:
      - nrf52840dk/nrf52840
      - nrf52840dongle/nrf52840
      - nrf21540dk/nrf52840
      - nrf5340dk/nrf5340/cpuapp
      - nrf54l15dk/nrf54l15/cpuapp
      - nrf54l15dk/nrf54l10/cpuapp
      - nrf54l15dk/nrf54l15/cpuapp/ns
      - nrf54lm20dk/nrf54lm20a/cpuapp
```

## prj.conf
```kconfig
#
# Copyright (c) 2020 Nordic Semiconductor
#
# SPDX-License-Identifier: LicenseRef-Nordic-5-Clause
#

# Enable OpenThread
CONFIG_OPENTHREAD=y

# nRF board library
CONFIG_DK_LIBRARY=y

# # Enable OpenThread CoAP support API
# CONFIG_OPENTHREAD_COAP=y

# Network shell
CONFIG_SHELL=y
CONFIG_OPENTHREAD_SHELL=y
CONFIG_SHELL_ARGC_MAX=26
CONFIG_SHELL_CMD_BUFF_SIZE=416

# Increase Settings storage size
CONFIG_PM_PARTITION_SIZE_SETTINGS_STORAGE=0x8000

# Enable OpenThread features set
CONFIG_OPENTHREAD_NORDIC_LIBRARY_MASTER=y

# Same network Master Key for client and server
CONFIG_OPENTHREAD_NETWORKKEY="00:11:22:33:44:55:66:77:88:99:aa:bb:cc:dd:ee:ff"
CONFIG_OPENTHREAD_PANID=4660
CONFIG_OPENTHREAD_XPANID="11:11:11:11:22:22:22:22"
CONFIG_OPENTHREAD_CHANNEL=15
CONFIG_MBEDTLS_SHA1_C=n
CONFIG_FPU=y

# Set product string for USB device
CONFIG_CDC_ACM_SERIAL_PRODUCT_STRING="OpenThread CoAP Router"

CONFIG_GPIO_SHELL=y

CONFIG_SYSTEM_WORKQUEUE_STACK_SIZE=2144

# Enable and configure Bluetooth LE
CONFIG_BT=y
CONFIG_BT_PERIPHERAL=y
CONFIG_BT_DEVICE_NAME="CRS DUT"
CONFIG_BT_DEVICE_APPEARANCE=833

CONFIG_CLI_SAMPLE_MULTIPROTOCOL=y


# Enforce building from sources when changing OpenThread configuration
CONFIG_OPENTHREAD_SOURCES=y

# TCP configuration
CONFIG_OPENTHREAD_TCP_ENABLE=y
CONFIG_OPENTHREAD_CLI_TCP_ENABLE=y
```

## boards/nrf42840dk_nrf52840.overlay
```dts
/* Copyright (c) 2020 Nordic Semiconductor ASA
 *
 * SPDX-License-Identifier: LicenseRef-Nordic-5-Clause
 */

 &uart0 {
	status = "okay";
	hw-flow-control;
};
```

## src/ble.c
```c
/*
 * Copyright (c) 2020 Nordic Semiconductor ASA
 *
 * SPDX-License-Identifier: LicenseRef-Nordic-5-Clause
 */

 #include <zephyr/kernel.h>
 #include <zephyr/bluetooth/gatt.h>
 
 #include "ble.h"
 
 #define DEVICE_NAME CONFIG_BT_DEVICE_NAME
 #define DEVICE_NAME_LEN (sizeof(DEVICE_NAME) - 1)
 
 #define ADV_INT_MIN 0x01e0 /* 300 ms */
 #define ADV_INT_MAX 0x0260 /* 380 ms */
 
 static const struct bt_data ad[] = {
	 BT_DATA_BYTES(BT_DATA_FLAGS, (BT_LE_AD_GENERAL | BT_LE_AD_NO_BREDR)),
	 BT_DATA(BT_DATA_NAME_COMPLETE, DEVICE_NAME, DEVICE_NAME_LEN),
 };
 
 static struct bt_conn_cb conn_callbacks;
 
 void ble_enable(void)
 {
	 const struct bt_le_adv_param *adv_param = BT_LE_ADV_PARAM(
		 BT_LE_ADV_OPT_CONN, ADV_INT_MIN, ADV_INT_MAX, NULL);
 
	 bt_enable(NULL);
	 bt_conn_cb_register(&conn_callbacks);
	 bt_le_adv_start(adv_param, ad, ARRAY_SIZE(ad), NULL, 0);
 }
 
```

## src/ble.h
```c
/**
 * @file
 * @defgroup ble Bluetooth LE API
 * @{
 */

/*
 * Copyright (c) 2020 Nordic Semiconductor ASA
 *
 * SPDX-License-Identifier: LicenseRef-Nordic-5-Clause
 */

 #ifndef __BLE_H__
 #define __BLE_H__
 
 /** @brief Initialize BLE.
  */
 void ble_enable(void);
 
 #endif
 
 /**
  * @}
  */
 
```

## src/coap_router.c
```c
/*
 * Copyright (c) 2020 Nordic Semiconductor ASA
 *
 * SPDX-License-Identifier: LicenseRef-Nordic-5-Clause
 */

#include <zephyr/drivers/uart.h>
#include <zephyr/kernel.h>
#include <zephyr/logging/log.h>
#include <dk_buttons_and_leds.h>
#include "ble.h"
#include <openthread/thread.h>
#include <zephyr/net/openthread.h>

LOG_MODULE_REGISTER(coap_server, CONFIG_OT_COMMAND_LINE_INTERFACE_LOG_LEVEL);

#define LEADER_LED DK_LED1
#define ROUTER_LED DK_LED3
#define CHILD_LED DK_LED3

static void on_thread_state_changed(otChangedFlags flags, void* user_data)
{
    if (flags & OT_CHANGED_THREAD_ROLE) {
        switch (otThreadGetDeviceRole(openthread_get_default_instance())) {
        case OT_DEVICE_ROLE_CHILD:
            dk_set_led_on(CHILD_LED);
            break;

        case OT_DEVICE_ROLE_ROUTER:
            dk_set_led_on(ROUTER_LED);
            break;

        case OT_DEVICE_ROLE_LEADER:
            dk_set_led_on(LEADER_LED);
            break;

        case OT_DEVICE_ROLE_DISABLED:
        case OT_DEVICE_ROLE_DETACHED:
        default:
            dk_set_led_off(LEADER_LED);
            dk_set_led_off(ROUTER_LED);
            dk_set_led_off(CHILD_LED);
            break;
        }
    }
}

static struct openthread_state_changed_callback ot_state_chaged_cb = {.otCallback = on_thread_state_changed};

int main(void)
{
    int ret;

#if DT_NODE_HAS_COMPAT(DT_CHOSEN(zephyr_shell_uart), zephyr_cdc_acm_uart)
    const struct device* dev;
    uint32_t dtr = 0U;

    dev = DEVICE_DT_GET(DT_CHOSEN(zephyr_shell_uart));
    if (dev == NULL) {
        LOG_ERR("Failed to find specific UART device");
        return 0;
    }

    LOG_INF("Waiting for host to be ready to communicate");

    /* Data Terminal Ready - check if host is ready to communicate */
    while (!dtr) {
        ret = uart_line_ctrl_get(dev, UART_LINE_CTRL_DTR, &dtr);
        if (ret) {
            LOG_ERR("Failed to get Data Terminal Ready line state: %d", ret);
            continue;
        }
        k_msleep(100);
    }

    /* Data Carrier Detect Modem - mark connection as established */
    (void)uart_line_ctrl_set(dev, UART_LINE_CTRL_DCD, 1);
    /* Data Set Ready - the NCP SoC is ready to communicate */
    (void)uart_line_ctrl_set(dev, UART_LINE_CTRL_DSR, 1);
#endif

    ret = dk_leds_init();
    if (ret) {
        LOG_ERR("Could not initialize leds, err code: %d", ret);
        return 0;
    }

    ble_enable();

    openthread_state_changed_callback_register(&ot_state_chaged_cb);
    openthread_run();

    return 0;
}
```
