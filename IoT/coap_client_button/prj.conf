## CMakeLists.txt
```
#
# Copyright (c) 2020 Nordic Semiconductor ASA
#
# SPDX-License-Identifier: LicenseRef-Nordic-5-Clause
#
cmake_minimum_required(VERSION 3.20.0)

find_package(Zephyr REQUIRED HINTS $ENV{ZEPHYR_BASE})

project(openthread_coap_client_button)

# NORDIC SDK APP START
target_sources(app PRIVATE src/coap_client_button.c src/coap_client_utils.c)

# NORDIC SDK APP END

target_sources_ifdef(CONFIG_BT_NUS app PRIVATE src/ble_utils.c)
target_include_directories(app PRIVATE src)
```

## prj.conf
```kconfig
#
# Copyright (c) 2020 Nordic Semiconductor
#
# SPDX-License-Identifier: LicenseRef-Nordic-5-Clause
#

# Enable OpenThread
CONFIG_OPENTHREAD=y

# nRF board library
CONFIG_DK_LIBRARY=y

# Enable CoAP utils and CoAP protocol
CONFIG_COAP=y
CONFIG_COAP_UTILS=y

# Generic networking options
CONFIG_NETWORKING=y

# Enable OpenThread CoAP support API
CONFIG_OPENTHREAD_COAP=y

# L2 OpenThread enabling
CONFIG_NET_L2_OPENTHREAD=y

# Network shell
CONFIG_SHELL=y
CONFIG_OPENTHREAD_SHELL=y
CONFIG_SHELL_ARGC_MAX=26
CONFIG_SHELL_CMD_BUFF_SIZE=416

# Increase Settings storage size
CONFIG_PM_PARTITION_SIZE_SETTINGS_STORAGE=0x8000

# Network sockets
CONFIG_NET_SOCKETS=y
CONFIG_ZVFS_POLL_MAX=4

# Same network Master Key for client and server
CONFIG_OPENTHREAD_NETWORKKEY="00:11:22:33:44:55:66:77:88:99:aa:bb:cc:dd:ee:ff"
CONFIG_OPENTHREAD_PANID=4660
CONFIG_OPENTHREAD_XPANID="11:11:11:11:22:22:22:22"
CONFIG_OPENTHREAD_CHANNEL=15
CONFIG_MBEDTLS_SHA1_C=n
CONFIG_FPU=y

# Increase main stack size to meet networking requirements
CONFIG_MAIN_STACK_SIZE=4096

# Set product string for USB device
CONFIG_CDC_ACM_SERIAL_PRODUCT_STRING="OpenThread CoAP Client Button"
# CONFIG_OPENTHREAD_MTD_SED=y
```

## src/coap_client_button.c
```c
/*
 * Copyright (c) 2020 Nordic Semiconductor ASA
 *
 * SPDX-License-Identifier: LicenseRef-Nordic-5-Clause
 */

#include <dk_buttons_and_leds.h>
#include <ram_pwrdn.h>
#include <zephyr/device.h>
#include <zephyr/kernel.h>
#include <zephyr/logging/log.h>
#include <zephyr/pm/device.h>

#include "coap_client_utils.h"
#include "ble_utils.h"

LOG_MODULE_REGISTER(coap_client, CONFIG_COAP_CLIENT_LOG_LEVEL);

#define OT_CONNECTION_LED DK_LED1
#define BLE_CONNECTION_LED DK_LED2
#define MTD_SED_LED DK_LED3

#if CONFIG_BT_NUS

static void on_ble_connect(struct k_work *item)
{
	ARG_UNUSED(item);

	dk_set_led_on(BLE_CONNECTION_LED);
}

static void on_ble_disconnect(struct k_work *item)
{
	ARG_UNUSED(item);

	dk_set_led_off(BLE_CONNECTION_LED);
}

#endif /* CONFIG_BT_NUS */

static void on_ot_connect(struct k_work* item)
{
    ARG_UNUSED(item);

    dk_set_led_on(OT_CONNECTION_LED);
}

static void on_ot_disconnect(struct k_work* item)
{
    ARG_UNUSED(item);

    dk_set_led_off(OT_CONNECTION_LED);
}

static void on_mtd_mode_toggle(uint32_t med)
{
#if IS_ENABLED(CONFIG_PM_DEVICE)
    const struct device* cons = DEVICE_DT_GET(DT_CHOSEN(zephyr_console));

    if (!device_is_ready(cons)) {
        return;
    }

    if (med) {
        pm_device_action_run(cons, PM_DEVICE_ACTION_RESUME);
    } else {
        pm_device_action_run(cons, PM_DEVICE_ACTION_SUSPEND);
    }
#endif
    dk_set_led(MTD_SED_LED, med);
}

static void on_button_changed(uint32_t button_state, uint32_t has_changed)
{
    uint32_t buttons = button_state & has_changed;

    if (buttons & DK_BTN2_MSK) {
        coap_client_toggle_mesh_lights();
    }

    if (buttons & DK_BTN3_MSK) {
        coap_client_toggle_minimal_sleepy_end_device();
    }
}

int main(void)
{
    int ret;

    if (IS_ENABLED(CONFIG_RAM_POWER_DOWN_LIBRARY)) {
        power_down_unused_ram();
    }

    ret = dk_buttons_init(on_button_changed);
    if (ret) {
        LOG_ERR("Cannot init buttons (error: %d)", ret);
        return 0;
    }

    ret = dk_leds_init();
    if (ret) {
        LOG_ERR("Cannot init leds, (error: %d)", ret);
        return 0;
    }

#if CONFIG_BT_NUS
    struct bt_nus_cb nus_clbs = {
        .received = NULL,
        .sent = NULL,
    };

    ret = ble_utils_init(&nus_clbs, on_ble_connect, on_ble_disconnect);
    if (ret) {
        LOG_ERR("Cannot init BLE utilities");
        return 0;
    }

#endif /* CONFIG_BT_NUS */

    coap_client_utils_init(on_ot_connect, on_ot_disconnect, on_mtd_mode_toggle);

    return 0;
}
```

## src/coap_client_utils.c
```c
/*
 * Copyright (c) 2020 Nordic Semiconductor ASA
 *
 * SPDX-License-Identifier: LicenseRef-Nordic-5-Clause
 */
#include <zephyr/kernel.h>
#include <net/coap_utils.h>
#include <zephyr/logging/log.h>
#include <zephyr/net/socket.h>
#include <openthread.h>
#include <openthread/thread.h>

#include "coap_client_utils.h"
LOG_MODULE_REGISTER(coap_client_utils, CONFIG_COAP_CLIENT_UTILS_LOG_LEVEL);

#define RESPONSE_POLL_PERIOD 100

static bool is_connected;

#define COAP_PORT 5683

enum light_command {
    THREAD_COAP_UTILS_LIGHT_0_CMD_TOGGLE = '0',
};

#define LIGHT_URI_PATH "light"

#define COAP_CLIENT_WORKQ_STACK_SIZE 2048
#define COAP_CLIENT_WORKQ_PRIORITY 5
K_THREAD_STACK_DEFINE(coap_client_workq_stack_area, COAP_CLIENT_WORKQ_STACK_SIZE);
static struct k_work_q coap_client_workq;
static struct k_work multicast_light_work;
static struct k_work toggle_MTD_SED_work;
static struct k_work on_connect_work;
static struct k_work on_disconnect_work;
mtd_mode_toggle_cb_t on_mtd_mode_toggle;

/* Options supported by the server */
static const char *const light_option[] = { LIGHT_URI_PATH, NULL };

/* Thread multicast mesh local address */
static struct sockaddr_in6 multicast_local_addr = {
    .sin6_family = AF_INET6,
    .sin6_port = htons(COAP_PORT),
    .sin6_addr.s6_addr = {0xff, 0x03, 0x00, 0x00, 0x00, 0x00, 0x00, 0x00, 0x00, 0x00, 0x00, 0x00, 0x00, 0x00, 0x00,
                          0x01},
    .sin6_scope_id = 0U};

/* Variable for storing server address acquiring in provisioning handshake */
static char unique_local_addr_str[INET6_ADDRSTRLEN];
static struct sockaddr_in6 unique_local_addr = {.sin6_family = AF_INET6,
                                                .sin6_port = htons(COAP_PORT),
                                                .sin6_addr.s6_addr =
                                                    {
                                                        0,
                                                    },
                                                .sin6_scope_id = 0U};

static void toggle_mesh_light_0(struct k_work* item)
{
    static uint8_t command = (uint8_t)THREAD_COAP_UTILS_LIGHT_0_CMD_TOGGLE;

    ARG_UNUSED(item);

    LOG_INF("Send multicast mesh 'light' request");
    coap_send_request(COAP_METHOD_PUT, (const struct sockaddr*)&multicast_local_addr, light_option, &command,
                      sizeof(command), NULL);
}

static void toggle_minimal_sleepy_end_device(struct k_work* item)
{
    otError error;
    otLinkModeConfig mode;
    struct otInstance* instance = openthread_get_default_instance();

    openthread_mutex_lock();
    mode = otThreadGetLinkMode(instance);
    mode.mRxOnWhenIdle = !mode.mRxOnWhenIdle;
    error = otThreadSetLinkMode(instance, mode);
    openthread_mutex_unlock();

    if (error != OT_ERROR_NONE) {
        LOG_ERR("Failed to set MLE link mode configuration");
    } else {
        on_mtd_mode_toggle(mode.mRxOnWhenIdle);
    }
}

static void update_device_state(void)
{
    struct otInstance* instance = openthread_get_default_instance();
    otLinkModeConfig mode = otThreadGetLinkMode(instance);
    on_mtd_mode_toggle(mode.mRxOnWhenIdle);
}

static void on_thread_state_changed(otChangedFlags flags, void* user_data)
{
    struct otInstance* instance = openthread_get_default_instance();

    if (flags & OT_CHANGED_THREAD_ROLE) {
        switch (otThreadGetDeviceRole(instance)) {
        case OT_DEVICE_ROLE_CHILD:
        case OT_DEVICE_ROLE_ROUTER:
        case OT_DEVICE_ROLE_LEADER:
            k_work_submit_to_queue(&coap_client_workq, &on_connect_work);
            is_connected = true;
            break;

        case OT_DEVICE_ROLE_DISABLED:
        case OT_DEVICE_ROLE_DETACHED:
        default:
            k_work_submit_to_queue(&coap_client_workq, &on_disconnect_work);
            is_connected = false;
            break;
        }
    }
}
static struct openthread_state_changed_callback ot_state_chaged_cb = {.otCallback = on_thread_state_changed};

void coap_client_utils_init(ot_connection_cb_t on_connect, ot_disconnection_cb_t on_disconnect,
                            mtd_mode_toggle_cb_t on_toggle)
{
    on_mtd_mode_toggle = on_toggle;

    coap_init(AF_INET6, NULL);

    k_work_queue_init(&coap_client_workq);
    k_work_queue_start(&coap_client_workq, coap_client_workq_stack_area,
                       K_THREAD_STACK_SIZEOF(coap_client_workq_stack_area), COAP_CLIENT_WORKQ_PRIORITY, NULL);

    k_work_init(&on_connect_work, on_connect);
    k_work_init(&on_disconnect_work, on_disconnect);
    k_work_init(&multicast_light_work, toggle_mesh_light_0);

    openthread_state_changed_callback_register(&ot_state_chaged_cb);
    openthread_run();

    if (IS_ENABLED(CONFIG_OPENTHREAD_MTD_SED)) {
        k_work_init(&toggle_MTD_SED_work, toggle_minimal_sleepy_end_device);
        update_device_state();
    }
}

static void submit_work_if_connected(struct k_work* work)
{
    if (is_connected) {
        k_work_submit_to_queue(&coap_client_workq, work);
    } else {
        LOG_INF("Connection is broken");
    }
}

void coap_client_toggle_mesh_lights(void) { submit_work_if_connected(&multicast_light_work); }

void coap_client_toggle_minimal_sleepy_end_device(void)
{
    if (IS_ENABLED(CONFIG_OPENTHREAD_MTD_SED)) {
        k_work_submit_to_queue(&coap_client_workq, &toggle_MTD_SED_work);
    }
}
```

## src/coap_client_utils.h
```c
/**
 * @file
 * @defgroup coap_client_utils API for coap_client_* samples
 * @{
 */

/*
 * Copyright (c) 2020 Nordic Semiconductor ASA
 *
 * SPDX-License-Identifier: LicenseRef-Nordic-5-Clause
 */

#ifndef __COAP_CLIENT_UTILS_H__
#define __COAP_CLIENT_UTILS_H__

/** @brief Type indicates function called when OpenThread connection
 *         is established.
 *
 * @param[in] item pointer to work item.
 */
typedef void (*ot_connection_cb_t)(struct k_work *item);

/** @brief Type indicates function called when OpenThread connection is ended.
 *
 * @param[in] item pointer to work item.
 */
typedef void (*ot_disconnection_cb_t)(struct k_work *item);

/** @brief Type indicates function called when the MTD modes are toggled.
 *
 * @param[in] val 1 if the MTD is in MED mode
 *                0 if the MTD is in SED mode
 */
typedef void (*mtd_mode_toggle_cb_t)(uint32_t val);

/** @brief Initialize CoAP client utilities.
 */
int coap_client_utils_init(ot_connection_cb_t on_connect,
			    ot_disconnection_cb_t on_disconnect,
			    mtd_mode_toggle_cb_t on_toggle);

/** @brief Toggle lights on all CoAP servers in the network mesh.
 */
void coap_client_toggle_mesh_lights(void);

/** @brief Toggle SED to MED and MED to SED modes.
 *
 * @note Active when the device is working as Minimal Thread Device.
 */
void coap_client_toggle_minimal_sleepy_end_device(void);

#endif

/**
 * @}
 */
```
