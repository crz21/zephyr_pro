## CMakeLists.txt
```
# SPDX-License-Identifier: Apache-2.0

cmake_minimum_required(VERSION 3.20.0)

find_package(Zephyr REQUIRED HINTS $ENV{ZEPHYR_BASE})

project(iot_server)

FILE(GLOB devices_sources src/devices/src/*.c)
FILE(GLOB protocol_sources src/protocol/src/*.c)
FILE(GLOB communicate_sources src/communicate/src/*.c)

target_sources(app PRIVATE src/main.c ${devices_sources} ${protocol_sources} ${communicate_sources})

target_include_directories(app PRIVATE src src/devices/inc src/protocol/inc src/communicate/inc)
include(${ZEPHYR_BASE}/samples/net/common/common.cmake)
set(gen_dir ${ZEPHYR_BINARY_DIR}/include/generated/)
```

## Kconfig
```
mainmenu "IoT Server"

menu "Application configuration"

config OT_COAP_SAMPLE_SERVER
	bool "Build the sample CoAP server application"

config OT_COAP_SAMPLE_LED
	bool "Enable LED support"
	default y

config OT_COAP_SAMPLE_SW
	bool "Enable switch support"
	default y

config OT_COAP_SHELL
	bool "Enable switch support"
	default n

config XXX_IMU
    bool "Enable AS201 IMU Support"
    default n
    help 
      This option enables the custom AS201 inertial measurement unit driver logic.

config LD2410C_DDRS
    bool "Enable LD2410C DDRS Support"
    default n
    help 
      This option enables the custom LD2410C Distance Detection Radar Sensor driver logic.

config AHT20_TS
    bool "Enable AHT20 TS Support"
    default n
    help 
      This option enables the custom AHT20 temperature sensor driver logic.

config BMP280_PS
    bool "Enable BMP280 Support"
    default n
    help 
      This option enables the custom BMP280 pressure sensor driver logic.

config LED_CT
    bool "Enable BLINK Support"
    default n
    help 
      This option enables the custom BLINK driver logic.

config BUTTON_CT
    bool "Enable BUTTON Support"
    default n
    help 
      This option enables the custom BLINK driver logic.

config OPEN_THREAD
    bool "Enable OPEN THREAD Support"
    default n
    help 
      This option enables the custom OPEN THREAD driver logic.

endmenu

source "Kconfig.zephyr"
```

## prj.conf
```kconfig
CONFIG_PRINTK=y
CONFIG_LOG=y
# CONFIG_ASSERT=n

# # IPC
CONFIG_EVENTS=y 

# # #MEM
CONFIG_HEAP_MEM_POOL_SIZE=2048

# gpio enable
CONFIG_GPIO=y

# i2c enable
CONFIG_I2C=y
CONFIG_I2C_NRFX=y

# uart enable
CONFIG_SERIAL=y
CONFIG_UART_ASYNC_API=y

# disable watchdog
CONFIG_WATCHDOG=y

# user custom function
CONFIG_LD2410C_DDRS=n
CONFIG_AHT20_TS=y
CONFIG_BMP280_PS=y

# # Enable MCUmgr and dependencies.
# #BT
# CONFIG_BT_CRS=y
# CONFIG_BT=y
# CONFIG_BT_PERIPHERAL=y
# # update data len
# CONFIG_BT_DATA_LEN_UPDATE=y
# CONFIG_BT_USER_DATA_LEN_UPDATE=y
# CONFIG_BT_CTLR_DATA_LENGTH_MAX=251
# CONFIG_BT_BUF_ACL_TX_SIZE=502
# CONFIG_BT_BUF_ACL_RX_SIZE=502
# CONFIG_BT_L2CAP_TX_MTU=498
# # update phy param
# CONFIG_BT_PHY_UPDATE=y
# CONFIG_BT_USER_PHY_UPDATE=y
# CONFIG_BT_CTLR_PHY_2M=y
# CONFIG_BT_CTLR_PHY_CODED=y
# # ble tx power
# CONFIG_BT_CTLR_TX_PWR_DYNAMIC_CONTROL=y
# CONFIG_BT_LL_SW_SPLIT=y
# # Set preferred values based on BT_BAP_CONN_PARAM_RELAXED
# CONFIG_BT_PERIPHERAL_PREF_MIN_INT=20
# CONFIG_BT_PERIPHERAL_PREF_MAX_INT=50
# CONFIG_BT_PERIPHERAL_PREF_LATENCY=0
# CONFIG_BT_PERIPHERAL_PREF_TIMEOUT=400

# CONFIG_KERNEL_BIN_NAME="V_m_1_0_11"
# CONFIG_BT_DEVICE_NAME="C_m_V_1_0_11"

# CONFIG_BOOTLOADER_MCUBOOT=y
# CONFIG_MCUMGR=y
# CONFIG_MCUMGR_TRANSPORT_BT=y
# CONFIG_MCUMGR_GRP_IMG=y
# CONFIG_MCUMGR_GRP_OS=y
# CONFIG_MCUMGR_TRANSPORT_BT_REASSEMBLY=y
# CONFIG_MCUMGR_GRP_OS_MCUMGR_PARAMS=y
# CONFIG_MCUMGR_TRANSPORT_BT_CONN_PARAM_CONTROL=y # OTA speed
# CONFIG_MCUMGR_TRANSPORT_NETBUF_SIZE=2475
# # OTA mmg
# CONFIG_FLASH=y
# CONFIG_FLASH_MAP=y
# CONFIG_STREAM_FLASH=y
# CONFIG_IMG_MANAGER=y
# CONFIG_NET_BUF=y
# CONFIG_ZCBOR=y

# CoAP
CONFIG_OPEN_THREAD=y
CONFIG_NETWORKING=y
CONFIG_NET_L2_OPENTHREAD=y
CONFIG_OPENTHREAD_COAP=y
CONFIG_OPENTHREAD_SLAAC=y
CONFIG_JSON_LIBRARY=y
# Logging
CONFIG_LOG_MAX_LEVEL=1
CONFIG_LOG_MODE_MINIMAL=n
CONFIG_BOOT_BANNER=y
CONFIG_LOG_BACKEND_UART=y
# Kernel options
CONFIG_MAIN_STACK_SIZE=2560
CONFIG_INIT_STACKS=y
# Add features required for FTD CLI
CONFIG_SHELL=y
CONFIG_OPENTHREAD_SHELL=y
CONFIG_OPENTHREAD_PING_SENDER=y
# # Network config
CONFIG_OPENTHREAD_PANID=4660
CONFIG_OPENTHREAD_XPANID="11:11:11:11:22:22:22:22"
CONFIG_OPENTHREAD_NETWORKKEY="00:11:22:33:44:55:66:77:88:99:aa:bb:cc:dd:ee:ff"
CONFIG_OPENTHREAD_CHANNEL=15
CONFIG_OPENTHREAD_NETWORK_NAME="OpenThreadDemo"
CONFIG_NVS=y
CONFIG_OT_COAP_SAMPLE_SERVER=n

CONFIG_MPSL=y
```

## src/main.c
```c
#include "main.h"

#include <zephyr/device.h>
#include <zephyr/kernel.h>
#include <zephyr/linker/linker-defs.h>
#include <zephyr/logging/log.h>
#include <zephyr/stats/stats.h>

#ifdef CONFIG_MCUMGR_GRP_FS
#include <zephyr/device.h>
#include <zephyr/fs/fs.h>
#include <zephyr/fs/littlefs.h>
#endif

#ifdef CONFIG_MCUMGR_GRP_STAT
#include <zephyr/mgmt/mcumgr/grp/stat_mgmt/stat_mgmt.h>
#endif

LOG_MODULE_REGISTER(smp_sample);

struct k_mutex i2c_mutex;

#ifdef CONFIG_MCUMGR_GRP_FS
#define STORAGE_PARTITION_LABEL storage_partition
#define STORAGE_PARTITION_ID FIXED_PARTITION_ID(STORAGE_PARTITION_LABEL)
FS_LITTLEFS_DECLARE_DEFAULT_CONFIG(cstorage);
static struct fs_mount_t littlefs_mnt = {
    .type = FS_LITTLEFS, .fs_data = &cstorage, .storage_dev = (void*)STORAGE_PARTITION_ID, .mnt_point = "/lfs1"};
#endif

#ifdef CONFIG_MCUMGR_GRP_STAT
/* Define an example stats group; approximates seconds since boot. */
STATS_SECT_START(smp_svr_stats)
STATS_SECT_ENTRY(ticks)
STATS_SECT_END;

/* Assign a name to the `ticks` stat. */
STATS_NAME_START(smp_svr_stats)
STATS_NAME(smp_svr_stats, ticks)
STATS_NAME_END(smp_svr_stats);

/* Define an instance of the stats group. */
STATS_SECT_DECL(smp_svr_stats) smp_svr_stats;
#endif

int main(void)
{
    printk("Address of sample %p\n", (void*)__rom_region_start);

#ifdef CONFIG_MCUMGR_GRP_STAT
    int rc = STATS_INIT_AND_REG(smp_svr_stats, STATS_SIZE_32, "smp_svr_stats");
    if (rc < 0) {
        LOG_ERR("Error initializing stats system [%d]", rc);
    }
#endif

#ifdef CONFIG_MCUMGR_GRP_FS
    rc = fs_mount(&littlefs_mnt);
    if (rc < 0) {
        LOG_ERR("Error mounting littlefs [%d]", rc);
    }
#endif

    k_mutex_init(&i2c_mutex);

    while (1) {
        k_sleep(K_MSEC(10));
#ifdef CONFIG_MCUMGR_GRP_STAT
        STATS_INC(smp_svr_stats, ticks);
#endif
    }
    return 0;
}
```

## src/main.h
```c
#ifndef __MAIN_H__
#define __MAIN_H__

#include <zephyr/kernel.h>

#include "protocol/inc/iot_producer.h"
#ifdef CONFIG_OPEN_THREAD
#include "protocol/inc/iot_coap_utils.h"

#include "devices/inc/iot_led.h"
#include "devices/inc/iot_button.h"
#endif
enum {
#ifdef CONFIG_AHT20_TS
    AHT20_TS_EVENT_NUM,
#endif

#ifdef CONFIG_BMP280_PS
    BMP280_PS_EVENT_NUM,
#endif

#ifdef CONFIG_LD2410C_DDRS
    LD2410C_DDRS_EVENT_NUM,
#endif
    MAX_EVENT_NUM
};

#ifdef CONFIG_BT_CRS
#include "communicate/inc/iot_ble.h"
#define BLE_PRIORITY (5)
#endif

#ifdef CONFIG_OPENTHREAD_IOT
#include "communicate/inc/iot_as201_imu.h"
#define OPENTHREAD_PRIORITY (5)
#endif

#ifdef CONFIG_DEBUG_UART
#include "communicate/inc/iot_debug_uart.h"
#define DEBUG_UART_PRIORITY (8)
#endif

#ifdef CONFIG_AHT20_TS
#include "devices/inc/iot_aht20_ts.h"
#define AHT20_TS_EVENT (1 << AHT20_TS_EVENT_NUM)
#define AHT20_TS_PRIORITY (5)
#endif

#ifdef CONFIG_BMP280_PS
#include "devices/inc/iot_bmp280_ps.h"
#define BMP280_PS_EVENT (1 << BMP280_PS_EVENT_NUM)
#define BMP280_PS_PRIORITY (5)
#endif

#ifdef CONFIG_LD2410C_DDRS
#include "devices/inc/iot_ld2410c_ddrs.h"
#define LD2410C_DDRS_EVENT (1 << LD2410C_DDRS_EVENT_NUM)
#define LD2410C_DDRS_PRIORITY (6)
#endif

#define PRODUCER_PRIORITY (4)
#define OPENTHREAD_PRIORITY (4)
extern struct k_mutex i2c_mutex;

#endif
```
