## CMakeLists.txt
```
#
# Copyright (c) 2020 Nordic Semiconductor ASA
#
# SPDX-License-Identifier: LicenseRef-Nordic-5-Clause
#
cmake_minimum_required(VERSION 3.20.0)

find_package(Zephyr REQUIRED HINTS $ENV{ZEPHYR_BASE})

project(openthread_coap_client_light)

# NORDIC SDK APP START
target_sources(app PRIVATE src/coap_client_light.c src/coap_client_utils.c)

# NORDIC SDK APP END

target_sources_ifdef(CONFIG_BT_NUS app PRIVATE src/ble_utils.c)
```

## Kconfig.sysbuild
```
#
# Copyright (c) 2024 Nordic Semiconductor ASA
#
# SPDX-License-Identifier: LicenseRef-Nordic-5-Clause
#

source "share/sysbuild/Kconfig"

config NRF_DEFAULT_IPC_RADIO
	default y

config NETCORE_IPC_RADIO_IEEE802154
	default y
```

## prj.conf
```kconfig
#
# Copyright (c) 2020 Nordic Semiconductor
#
# SPDX-License-Identifier: LicenseRef-Nordic-5-Clause
#

# nRF board library
CONFIG_DK_LIBRARY=y

# Enable CoAP utils and CoAP protocol
CONFIG_COAP=y
CONFIG_COAP_UTILS=y

# Generic networking options
CONFIG_NETWORKING=y

# L2 OpenThread enabling
CONFIG_NET_L2_OPENTHREAD=y

# Network shell
CONFIG_SHELL=y
CONFIG_OPENTHREAD_SHELL=y
CONFIG_SHELL_ARGC_MAX=26
CONFIG_SHELL_CMD_BUFF_SIZE=416

# Increase Settings storage size
CONFIG_PM_PARTITION_SIZE_SETTINGS_STORAGE=0x8000

# Network sockets
CONFIG_NET_SOCKETS=y
CONFIG_ZVFS_POLL_MAX=4

# Same network Master Key for client and server
CONFIG_OPENTHREAD_NETWORKKEY="00:11:22:33:44:55:66:77:88:99:aa:bb:cc:dd:ee:ff"
CONFIG_OPENTHREAD_PANID=4660
CONFIG_OPENTHREAD_XPANID="11:11:11:11:22:22:22:22"
CONFIG_OPENTHREAD_CHANNEL=15
CONFIG_MBEDTLS_SHA1_C=n
CONFIG_FPU=y

# Increase main stack size to meet networking requirements
CONFIG_MAIN_STACK_SIZE=4096

# Set product string for USB device
CONFIG_CDC_ACM_SERIAL_PRODUCT_STRING="OpenThread CoAP Client Light"
```

## src/coap_client.c
```c
/*
 * Copyright (c) 2020 Nordic Semiconductor ASA
 *
 * SPDX-License-Identifier: LicenseRef-Nordic-5-Clause
 */

#include <dk_buttons_and_leds.h>
#include <openthread/thread.h>
#include <zephyr/kernel.h>
#include <zephyr/logging/log.h>
#include <zephyr/net/openthread.h>

#include "ot_coap_utils.h"

LOG_MODULE_REGISTER(coap_server, CONFIG_COAP_SERVER_LOG_LEVEL);

#define LIGHT_LED_0 DK_LED1
#define LIGHT_LED_1 DK_LED2
#define LIGHT_LED_2 DK_LED3
#define LIGHT_LED_3 DK_LED4

#define COAP_SERVER_WORKQ_STACK_SIZE 512
#define COAP_SERVER_WORKQ_PRIORITY 5

K_THREAD_STACK_DEFINE(coap_server_workq_stack_area, COAP_SERVER_WORKQ_STACK_SIZE);
static struct k_work_q coap_server_workq;
static struct k_timer led_timer;

#if CONFIG_BT_NUS

#define COMMAND_REQUEST_UNICAST 'u'
#define COMMAND_REQUEST_MULTICAST 'm'
#define COMMAND_REQUEST_PROVISIONING 'p'

static void on_nus_received(struct bt_conn *conn, const uint8_t *const data, uint16_t len)
{
	LOG_INF("Received data: %c", data[0]);

	switch (*data) {
	case COMMAND_REQUEST_UNICAST:
		coap_client_toggle_one_light();
		break;

	case COMMAND_REQUEST_MULTICAST:
		coap_client_toggle_mesh_lights();
		break;

	case COMMAND_REQUEST_PROVISIONING:
		coap_client_send_provisioning_request();
		break;

	default:
		LOG_WRN("Received invalid data from NUS");
	}
}

static void on_ble_connect(struct k_work *item)
{
	ARG_UNUSED(item);

	dk_set_led_on(BLE_CONNECTION_LED);
}

static void on_ble_disconnect(struct k_work *item)
{
	ARG_UNUSED(item);

	dk_set_led_off(BLE_CONNECTION_LED);
}

#endif /* CONFIG_BT_NUS */

static void on_light_request(uint8_t command)
{
    static uint8_t led_0_staus;
    static uint8_t led_1_staus;
    static uint8_t led_2_staus;
    static uint8_t led_3_staus;

    switch (command) {
    case THREAD_COAP_UTILS_LIGHT_0_CMD_TOGGLE:
        led_0_staus = !led_0_staus;
        dk_set_led(LIGHT_LED_0, led_0_staus);
        break;

    case THREAD_COAP_UTILS_LIGHT_1_CMD_TOGGLE:
        led_1_staus = !led_1_staus;
        dk_set_led(LIGHT_LED_1, led_1_staus);
        break;

    case THREAD_COAP_UTILS_LIGHT_2_CMD_TOGGLE:
        led_2_staus = !led_2_staus;
        dk_set_led(LIGHT_LED_2, led_2_staus);
        break;

    case THREAD_COAP_UTILS_LIGHT_3_CMD_TOGGLE:
        led_3_staus = !led_3_staus;
        dk_set_led(LIGHT_LED_3, led_3_staus);
        break;

    default:
        break;
    }
}

static void activate_provisioning(struct k_work* item)
{
    ARG_UNUSED(item);

    ot_coap_activate_provisioning();

    k_timer_start(&led_timer, K_MSEC(100), K_MSEC(100));
    k_timer_start(&provisioning_timer, K_SECONDS(5), K_NO_WAIT);

    LOG_INF("Provisioning activated");
}

static void deactivate_provisionig(void)
{
    k_timer_stop(&led_timer);
    k_timer_stop(&provisioning_timer);

    if (ot_coap_is_provisioning_active()) {
        ot_coap_deactivate_provisioning();
        LOG_INF("Provisioning deactivated");
    }
}

static void on_provisioning_timer_expiry(struct k_timer* timer_id)
{
    ARG_UNUSED(timer_id);

    deactivate_provisionig();
}

static void on_led_timer_expiry(struct k_timer* timer_id)
{
    static uint8_t val = 1;

    ARG_UNUSED(timer_id);

    dk_set_led(PROVISIONING_LED, val);
    val = !val;
}

static void on_led_timer_stop(struct k_timer* timer_id)
{
    ARG_UNUSED(timer_id);

    dk_set_led_off(PROVISIONING_LED);
}

static void on_thread_state_changed(otChangedFlags flags, void* user_data)
{
    if (flags & OT_CHANGED_THREAD_ROLE) {
        switch (otThreadGetDeviceRole(openthread_get_default_instance())) {
        case OT_DEVICE_ROLE_CHILD:
        case OT_DEVICE_ROLE_ROUTER:
        case OT_DEVICE_ROLE_LEADER:
            break;

        case OT_DEVICE_ROLE_DISABLED:
        case OT_DEVICE_ROLE_DETACHED:
        default:
            deactivate_provisionig();
            break;
        }
    }
}

static struct openthread_state_changed_callback ot_state_chaged_cb = {.otCallback = on_thread_state_changed};

int main(void)
{
    int ret;

    LOG_INF("Start CoAP-server sample");

    k_timer_init(&led_timer, on_led_timer_expiry, on_led_timer_stop);
    k_work_queue_init(&coap_server_workq);
    k_work_queue_start(&coap_server_workq, coap_server_workq_stack_area,
                       K_THREAD_STACK_SIZEOF(coap_server_workq_stack_area), COAP_SERVER_WORKQ_PRIORITY, NULL);
    ret = ot_coap_init(&on_light_request);
    if (ret) {
        LOG_ERR("Could not initialize OpenThread CoAP");
        goto end;
    }

    ret = dk_leds_init();
    if (ret) {
        LOG_ERR("Could not initialize leds, err code: %d", ret);
        goto end;
    }

    openthread_state_changed_callback_register(&ot_state_chaged_cb);
    openthread_run();

#if CONFIG_BT_NUS
    struct bt_nus_cb nus_clbs = {
        .received = on_nus_received,
        .sent = NULL,
    };

    ret = ble_utils_init(&nus_clbs, on_ble_connect, on_ble_disconnect);
    if (ret) {
        LOG_ERR("Cannot init BLE utilities");
        return 0;
    }

#endif /* CONFIG_BT_NUS */

end:
    return 0;
}
```

## src/coap_client_light.c
```c
/*
 * Copyright (c) 2020 Nordic Semiconductor ASA
 *
 * SPDX-License-Identifier: LicenseRef-Nordic-5-Clause
 */

#include <dk_buttons_and_leds.h>
#include <openthread/thread.h>
#include <zephyr/kernel.h>
#include <zephyr/logging/log.h>
#include <zephyr/net/openthread.h>

#include "ot_coap_utils.h"

LOG_MODULE_REGISTER(coap_server, CONFIG_COAP_SERVER_LOG_LEVEL);

#define OT_CONNECTION_LED DK_LED1
#define BLE_CONNECTION_LED DK_LED2
#define MTD_SED_LED DK_LED3
#define LIGHT_LED DK_LED4

#define COAP_PORT 5683

enum light_command {
    THREAD_COAP_UTILS_LIGHT_0_CMD_TOGGLE = '0',
};

#if CONFIG_BT_NUS

#define COMMAND_REQUEST_MULTICAST 'm'

static void on_nus_received(struct bt_conn* conn, const uint8_t* const data, uint16_t len)
{
    LOG_INF("Received data: %c", data[0]);

    switch (*data) {
    case COMMAND_REQUEST_MULTICAST:
        coap_client_toggle_mesh_light_0();
        break;

    default:
        LOG_WRN("Received invalid data from NUS");
    }
}

static void on_ble_connect(struct k_work* item)
{
    ARG_UNUSED(item);

    dk_set_led_on(BLE_CONNECTION_LED);
}

static void on_ble_disconnect(struct k_work* item)
{
    ARG_UNUSED(item);

    dk_set_led_off(BLE_CONNECTION_LED);
}

#endif /* CONFIG_BT_NUS */

static void on_ot_connect(struct k_work* item)
{
    ARG_UNUSED(item);

    dk_set_led_on(OT_CONNECTION_LED);
}

static void on_ot_disconnect(struct k_work* item)
{
    ARG_UNUSED(item);

    dk_set_led_off(OT_CONNECTION_LED);
}

static void on_mtd_mode_toggle(uint32_t med)
{
#if IS_ENABLED(CONFIG_PM_DEVICE)
    const struct device* cons = DEVICE_DT_GET(DT_CHOSEN(zephyr_console));

    if (!device_is_ready(cons)) {
        return;
    }

    if (med) {
        pm_device_action_run(cons, PM_DEVICE_ACTION_RESUME);
    } else {
        pm_device_action_run(cons, PM_DEVICE_ACTION_SUSPEND);
    }
#endif
    dk_set_led(MTD_SED_LED, med);
}

static void on_button_changed(uint32_t button_state, uint32_t has_changed)
{
    uint32_t buttons = button_state & has_changed;

    if (buttons & DK_BTN3_MSK) {
        coap_client_toggle_minimal_sleepy_end_device();
    }
}

static void on_light_request(uint8_t command)
{
    static uint8_t led_0_staus;

    switch (command) {
    case THREAD_COAP_UTILS_LIGHT_0_CMD_TOGGLE:
        led_0_staus = !led_0_staus;
        dk_set_led(LIGHT_LED, led_0_staus);
        break;

    default:
        break;
    }
}

int main(void)
{
    int ret;

    if (IS_ENABLED(CONFIG_RAM_POWER_DOWN_LIBRARY)) {
        power_down_unused_ram();
    }

    ret = dk_buttons_init(on_button_changed);
    if (ret) {
        LOG_ERR("Cannot init buttons (error: %d)", ret);
        return 0;
    }

    ret = dk_leds_init();
    if (ret) {
        LOG_ERR("Could not initialize leds, err code: %d", ret);
        return 0;
    }

#if CONFIG_BT_NUS
    struct bt_nus_cb nus_clbs = {
        .received = on_nus_received,
        .sent = NULL,
    };

    ret = ble_utils_init(&nus_clbs, on_ble_connect, on_ble_disconnect);
    if (ret) {
        LOG_ERR("Cannot init BLE utilities");
        return 0;
    }

#endif /* CONFIG_BT_NUS */
    coap_client_utils_init(on_light_request, on_ot_connect, on_ot_disconnect, on_mtd_mode_toggle);

    return 0;
}
```

## src/coap_client_utils.c
```c
#include <openthread/coap.h>
#include <openthread/ip6.h>
#include <openthread/message.h>
#include <openthread/thread.h>
#include <zephyr/logging/log.h>
#include <zephyr/net/net_l2.h>
#include <zephyr/net/net_pkt.h>
#include <zephyr/net/openthread.h>

#include "ot_coap_utils.h"

LOG_MODULE_REGISTER(ot_coap_utils, CONFIG_OT_COAP_UTILS_LOG_LEVEL);
#define LIGHT_URI_PATH "light"
struct server_context {
    struct otInstance* ot;
    light_request_callback_t on_light_request;
};

static struct server_context srv_context = {
    .ot = NULL,
    .on_light_request = NULL,
};

/**@brief Definition of CoAP resources for light. */
static otCoapResource light_resource = {
    .mUriPath = LIGHT_URI_PATH,
    .mHandler = NULL,
    .mContext = NULL,
    .mNext = NULL,
};

#define COAP_CLIENT_WORKQ_STACK_SIZE 2048
#define COAP_CLIENT_WORKQ_PRIORITY 5
K_THREAD_STACK_DEFINE(coap_client_workq_stack_area, COAP_CLIENT_WORKQ_STACK_SIZE);
static struct k_work_q coap_client_workq;
static struct k_work toggle_MTD_SED_work;
static struct k_work on_connect_work;
static struct k_work on_disconnect_work;
mtd_mode_toggle_cb_t on_mtd_mode_toggle;

static void light_request_handler(void* context, otMessage* message, const otMessageInfo* message_info)
{
    uint8_t command;

    ARG_UNUSED(context);

    if (otCoapMessageGetType(message) != OT_COAP_TYPE_NON_CONFIRMABLE) {
        LOG_ERR("Light handler - Unexpected type of message");
        goto end;
    }

    if (otCoapMessageGetCode(message) != OT_COAP_CODE_PUT || otCoapMessageGetCode(message) != OT_COAP_CODE_POST) {
        LOG_ERR("Light handler - Unexpected CoAP code");
        goto end;
    }

    if (otMessageRead(message, otMessageGetOffset(message), &command, 1) != 1) {
        LOG_ERR("Light handler - Missing light command");
        goto end;
    }

    LOG_INF("Received light request: %c", command);

    srv_context.on_light_request(command);

end:
    return;
}

static void coap_default_handler(void* context, otMessage* message, const otMessageInfo* message_info)
{
    ARG_UNUSED(context);
    ARG_UNUSED(message);
    ARG_UNUSED(message_info);

    LOG_INF(
        "Received CoAP message that does not match any request "
        "or resource");
}

static void toggle_minimal_sleepy_end_device(struct k_work* item)
{
    otError error;
    otLinkModeConfig mode;
    struct otInstance* instance = openthread_get_default_instance();

    openthread_mutex_lock();
    mode = otThreadGetLinkMode(instance);
    mode.mRxOnWhenIdle = !mode.mRxOnWhenIdle;
    error = otThreadSetLinkMode(instance, mode);
    openthread_mutex_unlock();

    if (error != OT_ERROR_NONE) {
        LOG_ERR("Failed to set MLE link mode configuration");
    } else {
        on_mtd_mode_toggle(mode.mRxOnWhenIdle);
    }
}

static void update_device_state(void)
{
    struct otInstance* instance = openthread_get_default_instance();
    otLinkModeConfig mode = otThreadGetLinkMode(instance);
    on_mtd_mode_toggle(mode.mRxOnWhenIdle);
}

static void on_thread_state_changed(otChangedFlags flags, void* user_data)
{
    struct otInstance* instance = openthread_get_default_instance();

    if (flags & OT_CHANGED_THREAD_ROLE) {
        switch (otThreadGetDeviceRole(instance)) {
        case OT_DEVICE_ROLE_CHILD:
        case OT_DEVICE_ROLE_ROUTER:
        case OT_DEVICE_ROLE_LEADER:
            k_work_submit_to_queue(&coap_client_workq, &on_connect_work);
            is_connected = true;
            break;

        case OT_DEVICE_ROLE_DISABLED:
        case OT_DEVICE_ROLE_DETACHED:
        default:
            k_work_submit_to_queue(&coap_client_workq, &on_disconnect_work);
            is_connected = false;
            break;
        }
    }
}
static struct openthread_state_changed_callback ot_state_chaged_cb = {.otCallback = on_thread_state_changed};

int coap_client_utils_init(light_request_callback_t on_light_request, ot_connection_cb_t on_connect,
                           ot_disconnection_cb_t on_disconnect, mtd_mode_toggle_cb_t on_toggle)
{
    otError error;

    on_mtd_mode_toggle = on_toggle;
    srv_context.on_light_request = on_light_request;

    srv_context.ot = openthread_get_default_instance();
    if (!srv_context.ot) {
        LOG_ERR("There is no valid OpenThread instance");
        error = OT_ERROR_FAILED;
        goto end;
    }

    light_resource.mContext = srv_context.ot;
    light_resource.mHandler = light_request_handler;

    otCoapSetDefaultHandler(srv_context.ot, coap_default_handler, NULL);
    otCoapAddResource(srv_context.ot, &light_resource);

    k_work_queue_init(&coap_client_workq);
	k_work_queue_start(&coap_client_workq, coap_client_workq_stack_area,
					K_THREAD_STACK_SIZEOF(coap_client_workq_stack_area),
					COAP_CLIENT_WORKQ_PRIORITY, NULL);

	k_work_init(&on_connect_work, on_connect);
	k_work_init(&on_disconnect_work, on_disconnect);
    openthread_state_changed_callback_register(&ot_state_chaged_cb);
    openthread_run();

    if (IS_ENABLED(CONFIG_OPENTHREAD_MTD_SED)) {
        k_work_init(&toggle_MTD_SED_work, toggle_minimal_sleepy_end_device);
        update_device_state();
    }
    error = otCoapStart(srv_context.ot, COAP_PORT);
    if (error != OT_ERROR_NONE) {
        LOG_ERR("Failed to start OT CoAP. Error: %d", error);
        goto end;
    }

end:
    return error == OT_ERROR_NONE ? 0 : 1;
}

void coap_client_toggle_minimal_sleepy_end_device(void)
{
    if (IS_ENABLED(CONFIG_OPENTHREAD_MTD_SED)) {
        k_work_submit_to_queue(&coap_client_workq, &toggle_MTD_SED_work);
    }
}
```

## src/coap_client_utils.h
```c
/*
 * Copyright (c) 2020 Nordic Semiconductor ASA
 *
 * SPDX-License-Identifier: LicenseRef-Nordic-5-Clause
 */

 #ifndef __OT_COAP_UTILS_H__
 #define __OT_COAP_UTILS_H__
 
 #include <coap_server_client_interface.h>
 
 /**@brief Type definition of the function used to handle light resource change.
  */
 typedef void (*light_request_callback_t)(uint8_t cmd);
 
 int ot_coap_init(light_request_callback_t on_light_request);

 #endif
 
```
